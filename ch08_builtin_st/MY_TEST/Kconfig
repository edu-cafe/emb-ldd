## ch08_builtin_st/MY_TEST/Kconfig
```kconfig
menuconfig MY_TEST
    bool "RaspberryPi MY_TEST"
	depends on ARCH_BCM2835
    ---help---

if MY_TEST

config MY_LED
	tristate "MY LED support"
	depends on ARCH_BCM2835
	help

endif
```
